## boards/shields/another/Kconfig.defconfig
```kconfig
if SHIELD_ANOTHER_LEFT

config ZMK_KEYBOARD_NAME
    default "Another"

config ZMK_SPLIT_ROLE_CENTRAL
    default y

endif

if SHIELD_ANOTHER_LEFT || SHIELD_ANOTHER_RIGHT

config ZMK_SPLIT
    default y

endif
```

## boards/shields/another/Kconfig.shield
```kconfig
config SHIELD_ANOTHER_LEFT
   def_bool $(shields_list_contains,another_left)

config SHIELD_ANOTHER_RIGHT
   def_bool $(shields_list_contains,another_right)
```
